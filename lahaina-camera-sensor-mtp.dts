// SPDX-License-Identifier: BSD-3-Clause
/*
 * Copyright (c) Qualcomm Technologies, Inc. and/or its subsidiaries.
 */

/dts-v1/;
/plugin/;

#include <dt-bindings/interconnect/qcom,lahaina.h>
#include <dt-bindings/clock/qcom,camcc-sm8350.h>
#include <dt-bindings/clock/qcom,gcc-sm8350.h>
#include <dt-bindings/interrupt-controller/arm-gic.h>
#include <dt-bindings/regulator/qcom,rpmh-regulator-levels.h>

#include "lahaina-camera-sensor-mtp.dtsi"

/ {
	model = "Qualcomm Technologies, Inc. Lahaina MTP";
	compatible = "qcom,lahaina-mtp", "qcom,lahaina", "qcom,mtp";
	qcom,msm-id = <415 0x20001>, <456 0x20001>, <501 0x20001>,
		      <415 0x20000>, <456 0x20000>, <501 0x20000>;
	qcom,board-id = <0x20108 0>, <0x20008 0>, <0x10008 0>;
};
