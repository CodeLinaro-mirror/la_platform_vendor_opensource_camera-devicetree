// SPDX-License-Identifier: BSD-3-Clause
/*
 * Copyright (c) Qualcomm Technologies, Inc. and/or its subsidiaries.
 */

/dts-v1/;
/plugin/;

#include <dt-bindings/clock/qcom,gcc-kera.h>
#include <dt-bindings/clock/qcom,camcc-sun.h>
#include <dt-bindings/clock/qcom,cambistmclkcc-sun.h>
#include <dt-bindings/interconnect/qcom,kera.h>
#include <dt-bindings/interrupt-controller/arm-gic.h>
#include <dt-bindings/regulator/qcom,rpmh-regulator-levels.h>

#include "kera-camera-sensor-mtp.dtsi"
/ {
	model = "Qualcomm Technologies, Inc. Kera RCM";
	compatible = "qcom,kera-rcm", "qcom,kera", "qcom,kerap-rcm", "qcom,kerap",
                        "qcom,rcm";
	qcom,msm-id = <686 0x10000>, <686 0x20000>, <659 0x10000>, <659 0x20000>,
                        <731 0x10000>, <732 0x10000>;
	qcom,board-id = <0x10015 0>, <0x20015 0>, <0x30015 0>, <0x10015 1>,
                        <0x20015 1>, <0x30015 1>, <0x10015 2>, <0x20015 2>,
                        <0x30015 2>, <0x40015 2>;
};
