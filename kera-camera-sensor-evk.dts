// SPDX-License-Identifier: BSD-3-Clause
/*
 * Copyright (c) Qualcomm Technologies, Inc. and/or its subsidiaries.
 */

/dts-v1/;
/plugin/;

#include <dt-bindings/clock/qcom,gcc-kera.h>
#include <dt-bindings/clock/qcom,camcc-sun.h>
#include <dt-bindings/clock/qcom,cambistmclkcc-sun.h>
#include <dt-bindings/interconnect/qcom,kera.h>
#include <dt-bindings/interrupt-controller/arm-gic.h>
#include <dt-bindings/regulator/qcom,rpmh-regulator-levels.h>

#include "kera-camera-sensor-evk.dtsi"
/ {
	model = "Qualcomm Technologies, Inc. Kera EVK + eMMC";
	compatible = "qcom,kera-evk", "qcom,kera", "qcom,kerap-evk", "qcom,kerap",
                        "qcom,evk";
	qcom,msm-id = <731 0x10000>, <732 0x10000>, <731 0x20000>, <732 0x20000>;
	qcom,board-id = <0x1002F 0>;
};
