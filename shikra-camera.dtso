/*
 * Copyright (c) Qualcomm Technologies, Inc. and/or its subsidiaries.
 * SPDX-License-Identifier: BSD-3-Clause
*/

/dts-v1/;
/plugin/;

#include "shikra-camera.dtsi"
#include "shikra-camera-sensor.dtsi"

/ {
	model = "Qualcomm Technologies, Inc. Shikra Camera";
	compatible = "qcom,shikra-camera", "qcom,shikra";
	qcom,msm-id = <756 0x10000>, <758 0x10000 >, <759 0x10000>;
	qcom,board-id = <0 0x0>, <0 0x1>, <15 0>,
                        <0 0x300>, <0 0x301>,
                        <0 0x400>, <0 0x401>,
                        <0 0x500>, <0 0x501>;
};
