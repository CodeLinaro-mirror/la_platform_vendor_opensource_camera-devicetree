// SPDX-License-Identifier: BSD-3-Clause
/*
 * Copyright (c) Qualcomm Technologies, Inc. and/or its subsidiaries.
 */

/dts-v1/;
/plugin/;

#include <dt-bindings/clock/qcom,gcc-kera.h>
#include <dt-bindings/clock/qcom,camcc-sun.h>
#include <dt-bindings/clock/qcom,cambistmclkcc-sun.h>
#include <dt-bindings/interconnect/qcom,kera.h>
#include <dt-bindings/interrupt-controller/arm-gic.h>
#include <dt-bindings/regulator/qcom,rpmh-regulator-levels.h>

#include "kera-camera-sensor-mtp.dtsi"
#include "kera-camera-sensor-rcm-emmc.dtsi"

/ {
	model = "Qualcomm Technologies, Inc. Kera RCM + eMMC";
	compatible = "qcom,kera-rcm", "qcom,kera", "qcom,kerap-rcm", "qcom,kerap",
                        "qcom,rcm";
	qcom,msm-id = <731 0x10000>, <732 0x10000>, <731 0x20000>, <732 0x20000>;
	qcom,board-id = <0x30015 2>, <0x40015 2>;
};
